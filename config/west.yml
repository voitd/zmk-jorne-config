## config/west.yml
```yaml
manifest:
  remotes:
    - name: voitd
      url-base: https://github.com/voitd
  projects:
    - name: voitd
      remote: zmkfirmware
      revision: main
      import: app/west.yml
  self:
    path: config
```
